## boards/shields/eternal_keypad/Kconfig.defconfig
```kconfig
# Copyright (c) 2022 The ZMK Contributors
# SPDX-License-Identifier: MIT

if SHIELD_ETERNAL_KEYPAD_CUSTOM || SHIELD_ETERNAL_KEYPAD_LEFTY_CUSTOM

config ZMK_KEYBOARD_NAME
	default "Eternal Keypad"

config ZMK_STUDIO
    default n
		
endif
```

## boards/shields/eternal_keypad/Kconfig.shield
```kconfig
# Copyright (c) 2022 The ZMK Contributors
# SPDX-License-Identifier: MIT

config SHIELD_ETERNAL_KEYPAD_CUSTOM
	def_bool $(shields_list_contains,eternal_keypad_custom)

	config SHIELD_ETERNAL_KEYPAD_LEFTY_CUSTOM
	def_bool $(shields_list_contains,eternal_keypad_lefty_custom)
```
